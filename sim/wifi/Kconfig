## sim/wifi/Kconfig
```kconfig
# Fake (simulated) Wi-Fi offload backend for tests
#
# SPDX-License-Identifier: Apache-2.0

config NETWORK_PROV_FAKE_WIFI
	bool "Fake (simulated) Wi-Fi driver for tests"
	depends on NETWORKING
	select WIFI
	select WIFI_USE_NATIVE_NETWORKING
	select NET_L2_ETHERNET
	select NET_L2_WIFI_MGMT
	help
	  A hardware-less Wi-Fi offload network interface for native_sim and
	  nrf52_bsim. It registers a WIFI-type interface and answers
	  scan/connect/iface_status/ap_enable with programmable, deterministic
	  results so the full provisioning manager can be exercised in simulation,
	  including failure injection. Test-only: the real samples never enable it.

if NETWORK_PROV_FAKE_WIFI

config NETWORK_PROV_FAKE_WIFI_MAX_AP
	int "Maximum number of canned scan APs"
	default 8
	help
	  Upper bound on the canned access-point list the fake backend reports
	  from a scan.

endif # NETWORK_PROV_FAKE_WIFI
```

## tests/bsim/ble_e2e/testcase.yaml
```yaml
tests:
  network_provisioning.bsim.ble_e2e:
    build_only: true
    harness: bsim
    platform_allow:
      - nrf52_bsim/native
    integration_platforms:
      - nrf52_bsim/native
    tags:
      - network_provisioning
      - bluetooth
    harness_config:
      bsim_exe_name: network_provisioning_bsim_ble_e2e_prj_conf
```

## tests/fake_wifi/testcase.yaml
```yaml
tests:
  network_provisioning.fake_wifi:
    tags:
      - network_provisioning
      - wifi
    platform_allow:
      - native_sim
    integration_platforms:
      - native_sim
```

## tests/protocomm/testcase.yaml
```yaml
tests:
  network_provisioning.protocomm:
    modules:
      - nanopb
    tags:
      - network_provisioning
    platform_allow:
      - native_sim
    integration_platforms:
      - native_sim
```

## tests/protocomm_http/testcase.yaml
```yaml
tests:
  network_provisioning.protocomm_http:
    modules:
      - nanopb
    tags:
      - network_provisioning
    platform_allow:
      - native_sim
    integration_platforms:
      - native_sim
```

## tests/security1/testcase.yaml
```yaml
tests:
  network_provisioning.security1:
    modules:
      - nanopb
    tags:
      - network_provisioning
    platform_allow:
      - native_sim
    integration_platforms:
      - native_sim
```

## west.yml
```yaml
# West manifest so this repository can be used standalone:
#   west init -m https://github.com/beriberikix/network-provisioning-zephyr
#   west update
#
# Zephyr is imported with its own manifest. nanopb is NOT part of Zephyr's
# default manifest, so it is added here explicitly (the module compiles the
# protobuf definitions under proto/).
manifest:
  remotes:
    - name: zephyrproject-rtos
      url-base: https://github.com/zephyrproject-rtos

  projects:
    - name: zephyr
      remote: zephyrproject-rtos
      # Pinned to the latest stable release. Moving to a newer release is a
      # one-line bump here; CI builds the sample and runs the unit tests
      # against whatever this pins.
      revision: v4.4.1
      import: true

    - name: nanopb
      remote: zephyrproject-rtos
      # Keep in sync with the nanopb revision Zephyr's own manifest pins for
      # the release above.
      revision: 5499fd4c9a478f8139eeb07a82c3b4468d6067f7
      path: modules/lib/nanopb

  self:
    path: network-provisioning-zephyr
```
