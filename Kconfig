## tests/bsim/thread_e2e/testcase.yaml
```yaml
tests:
  network_provisioning.bsim.thread_e2e:
    build_only: true
    harness: bsim
    platform_allow:
      - nrf52_bsim/native
    integration_platforms:
      - nrf52_bsim/native
    tags:
      - network_provisioning
      - thread
    harness_config:
      bsim_exe_name: network_provisioning_bsim_thread_e2e_prj_conf
```

## tests/console/testcase.yaml
```yaml
tests:
  network_provisioning.console:
    modules:
      - nanopb
    tags:
      - network_provisioning
      - wifi
    platform_allow:
      - native_sim
    integration_platforms:
      - native_sim
```

## tests/manager_api/testcase.yaml
```yaml
tests:
  network_provisioning.manager_api:
    modules:
      - nanopb
    tags:
      - network_provisioning
      - wifi
    platform_allow:
      - native_sim
    integration_platforms:
      - native_sim
```
