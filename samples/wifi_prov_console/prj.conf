## CMakeLists.txt
```
# SPDX-License-Identifier: Apache-2.0

cmake_minimum_required(VERSION 3.20.0)

find_package(Zephyr REQUIRED HINTS $ENV{ZEPHYR_BASE})
project(wifi_prov_console)

target_sources(app PRIVATE src/main.c)
```

## sample.yaml
```
sample:
  name: Wi-Fi Provisioning over the Console
  description: >
    Provision Wi-Fi credentials over the device console (shell) using a secure
    protocomm session, for boards with Wi-Fi but no usable BLE/SoftAP transport
    under Zephyr (e.g. the Raspberry Pi Pico 2W). Speaks the transport
    "esp_prov --transport console" uses, backed by Zephyr's native
    wifi_credentials store.
tests:
  sample.net.wifi_prov_console:
    platform_allow:
      - native_sim
      - rpi_pico2/rp2350a/m33_0/w
    integration_platforms:
      - native_sim
    tags:
      - wifi
      - provisioning
      - console
    build_only: true
```

## prj.conf
```kconfig
# Wi-Fi provisioning over the device console (shell)
#
# SPDX-License-Identifier: Apache-2.0

# --- Provisioning service ---------------------------------------------------
CONFIG_NETWORK_PROV_MGR=y
CONFIG_NETWORK_PROV_CONSOLE=y

# --- Console transport (shell over the serial console) ----------------------
CONFIG_SHELL=y
CONFIG_SHELL_CMD_BUFF_SIZE=512

# --- Wi-Fi station + networking ---------------------------------------------
# CONFIG_WIFI auto-enables the board's Wi-Fi driver (e.g. WIFI_AIROC on the
# Pico 2W), which selects NET_L2_ETHERNET + NET_L2_WIFI_MGMT + WIFI_OFFLOAD.
CONFIG_WIFI=y
CONFIG_NETWORKING=y
CONFIG_NET_IPV4=y
CONFIG_NET_DHCPV4=y
CONFIG_NET_MGMT=y
CONFIG_NET_MGMT_EVENT=y
CONFIG_NET_MGMT_EVENT_INFO=y
CONFIG_NET_L2_WIFI_MGMT=y

# --- Credential storage (native wifi_credentials, settings backend) ---------
CONFIG_WIFI_CREDENTIALS=y
CONFIG_WIFI_CREDENTIALS_BACKEND_SETTINGS=y
CONFIG_SETTINGS=y
CONFIG_FLASH=y
CONFIG_FLASH_MAP=y
CONFIG_NVS=y
CONFIG_SETTINGS_NVS=y

# --- Crypto: PSA (mbedTLS) for security scheme 1 ----------------------------
# X25519 key agreement + AES-256-CTR + SHA-256.
CONFIG_PSA_CRYPTO=y
CONFIG_MBEDTLS=y
CONFIG_MBEDTLS_PSA_CRYPTO_C=y
CONFIG_MBEDTLS_ENABLE_HEAP=y
CONFIG_MBEDTLS_HEAP_SIZE=16384
CONFIG_ENTROPY_GENERATOR=y
# PSA features the security-1 handshake actually exercises.
CONFIG_PSA_WANT_ALG_ECDH=y
CONFIG_PSA_WANT_ECC_MONTGOMERY_255=y
CONFIG_PSA_WANT_KEY_TYPE_ECC_KEY_PAIR_GENERATE=y
CONFIG_PSA_WANT_KEY_TYPE_ECC_KEY_PAIR_EXPORT=y
CONFIG_PSA_WANT_KEY_TYPE_ECC_KEY_PAIR_DERIVE=y
CONFIG_PSA_WANT_ALG_CTR=y
CONFIG_PSA_WANT_KEY_TYPE_AES=y
CONFIG_PSA_WANT_ALG_SHA_256=y

# --- Protobuf ---------------------------------------------------------------
CONFIG_NANOPB=y

# --- Runtime resources ------------------------------------------------------
CONFIG_HEAP_MEM_POOL_SIZE=65536
CONFIG_MAIN_STACK_SIZE=4096
CONFIG_SYSTEM_WORKQUEUE_STACK_SIZE=4096

# --- Logging ----------------------------------------------------------------
# Logs and the shell share the console UART; keep logging at INFO so manager
# diagnostics stay readable without burying the net_prov response lines.
CONFIG_LOG=y
CONFIG_NETWORK_PROV_LOG_LEVEL_INF=y
CONFIG_PRINTK=y
```

## boards/rpi_pico2_rp2350a_m33_w.conf
```kconfig
# Raspberry Pi Pico 2W: run the console/shell over SEGGER RTT, read through the
# SWD debug probe with OpenOCD. The Pico 2W is already flashed/debugged over
# SWD, so RTT reuses that link — no UART wiring and no USB-CDC needed.
#
# (The USB-next CDC-ACM console hits an iterable-section .data-init fault on
# this board/Zephyr; RTT sidesteps the USB device stack entirely.)
#
# SPDX-License-Identifier: Apache-2.0

CONFIG_USE_SEGGER_RTT=y
CONFIG_SHELL_BACKEND_SERIAL=n
CONFIG_SHELL_BACKEND_RTT=y

# Handy on the console: inspect the network/Wi-Fi state and scan from the shell.
CONFIG_NET_SHELL=y
CONFIG_NET_L2_WIFI_SHELL=y
```

## boards/rpi_pico2_rp2350a_m33_0_w.overlay
```dts
/*
 * Raspberry Pi Pico 2W board overlay for wifi_prov_console.
 *
 * Carve a storage partition out of the 4 MB flash for the wifi_credentials
 * settings/NVS backend. The base rpi_pico2 board gives the whole flash to a
 * single code partition, so without this the FLASH_MAP/NVS storage has nowhere
 * to live. Overriding it shrinks code_partition to 1 MB. This is the
 * standard Raspberry Pi 4 MB layout (1 MB code, 3 MB storage), the same
 * include the seeed/xiao_rp2350 board uses.
 *
 * The console/shell run over SEGGER RTT (see the board .conf) so no UART or
 * USB wiring is needed beyond the SWD debug probe.
 *
 * SPDX-License-Identifier: Apache-2.0
 */

#include <raspberrypi/partitions_4M_storage.dtsi>
```

## boards/rpi_pico2_rp2350a_m33_w.overlay
```dts
/*
 * Raspberry Pi Pico 2W board overlay for wifi_prov_console.
 *
 * Carve a storage partition out of the 4 MB flash for the wifi_credentials
 * settings/NVS backend. The base rpi_pico2 board defines no flash partitions,
 * so without this the FLASH_MAP/NVS storage has nowhere to live. This is the
 * standard Raspberry Pi 4 MB layout (1 MB code, 3 MB storage), the same
 * include the seeed/xiao_rp2350 board uses.
 *
 * The console/shell run over SEGGER RTT (see the board .conf) so no UART or
 * USB wiring is needed beyond the SWD debug probe.
 *
 * SPDX-License-Identifier: Apache-2.0
 */

#include <raspberrypi/partitions_4M_storage.dtsi>
```

## src/main.c
```c
/*
 * Wi-Fi provisioning over the device console (shell) sample.
 *
 * Carries the provisioning protocol over a single shell command,
 *
 *     net_prov <endpoint> <session_id> <hex-request>
 *
 * — the transport esp_prov speaks with `--transport console`. On reboot, if
 * credentials are already stored, the sample connects with them instead —
 * retrying with backoff, and falling back to provisioning mode (credentials
 * kept) if the network stays unreachable.
 *
 * This is the transport used on boards that have Wi-Fi but no usable
 * Bluetooth/SoftAP path under Zephyr — most notably the Raspberry Pi Pico 2W
 * (CYW43439), where the in-tree drivers provide Wi-Fi STA only (no CYW43 BLE
 * HCI, and the AIROC driver has no concurrent SoftAP+STA). See the README.
 *
 * SPDX-License-Identifier: Apache-2.0
 */

#include <string.h>
#include <errno.h>
#include <zephyr/kernel.h>
#include <zephyr/logging/log.h>
#include <zephyr/net/net_if.h>
#include <zephyr/net/net_mgmt.h>
#include <zephyr/net/wifi_mgmt.h>
#include <zephyr/net/wifi_credentials.h>

#include <network_provisioning/network_prov_mgr.h>
#include <network_provisioning/scheme_console.h>

LOG_MODULE_REGISTER(app, LOG_LEVEL_INF);

/* Proof-of-possession the client must supply to complete the security-1
 * handshake. Set to an empty string to advertise the "no_pop" capability.
 */
#define PROV_POP          "abcd1234"
/* The console scheme ignores the service name (no BLE name / AP SSID to set);
 * it is reported only in the proto-ver capabilities for parity with the other
 * transports.
 */
#define PROV_DEVICE_NAME  "PROV_ZEPHYR"

/* Stored-credential reconnect policy (reboot path). Credentials are never
 * erased automatically — after the attempts below the sample re-enters
 * provisioning mode and tries the stored credentials again on the next boot.
 * For an explicit factory reset (e.g. a button), call
 * network_prov_mgr_reset_wifi_provisioning().
 */
#define SAVED_CONN_ATTEMPTS    5
#define SAVED_CONN_TIMEOUT     K_SECONDS(45)
#define SAVED_CONN_BACKOFF_MAX 16 /* seconds */

/* Example custom endpoint handler: echoes the request back to the client. */
static int app_custom_handler(void *ctx, const uint8_t *inbuf, size_t inlen,
			      uint8_t **outbuf, size_t *outlen)
{
	ARG_UNUSED(ctx);
	if (inlen == 0) {
		*outbuf = NULL;
		*outlen = 0;
		return 0;
	}

	uint8_t *out = k_malloc(inlen);

	if (out == NULL) {
		return -ENOMEM;
	}
	memcpy(out, inbuf, inlen);
	*outbuf = out;
	*outlen = inlen;
	return 0;
}

static void prov_event(void *user_data, enum network_prov_cb_event event,
		       void *event_data)
{
	ARG_UNUSED(user_data);

	switch (event) {
	case NETWORK_PROV_START:
		LOG_INF("Provisioning started; drive it from the console");
		LOG_INF("  shell command : net_prov <endpoint> <session_id> <hex>");
		LOG_INF("  esp_prov      : esp_prov --transport console "
			"--sec_ver 1 --pop %s ...", PROV_POP[0] ? PROV_POP : "(none)");
		/* Attach the custom endpoint's handler now the service is up. */
		(void)network_prov_mgr_endpoint_register("custom-data",
							 app_custom_handler, NULL);
		break;
	case NETWORK_PROV_CRED_RECV:
		LOG_INF("Wi-Fi credentials received, connecting...");
		break;
	case NETWORK_PROV_CRED_FAIL:
		LOG_ERR("Provisioning failed; check the SSID/passphrase and retry");
		break;
	case NETWORK_PROV_CRED_SUCCESS:
		LOG_INF("Provisioning successful, Wi-Fi connected");
		break;
	case NETWORK_PROV_END:
		LOG_INF("Provisioning finished");
		break;
	default:
		break;
	}
}

/* Connect-result plumbing for the stored-credential (reboot) path. The
 * manager's own handler only runs while provisioning is active, so the sample
 * tracks the result of its own connect attempts here.
 */
static K_SEM_DEFINE(conn_result_sem, 0, 1);
static int conn_result_status;
static struct net_mgmt_event_callback conn_cb;

static void conn_mgmt_event(struct net_mgmt_event_callback *cb, uint64_t event,
			    struct net_if *iface)
{
	ARG_UNUSED(iface);

	if (event == NET_EVENT_WIFI_CONNECT_RESULT) {
		const struct wifi_status *status =
			(const struct wifi_status *)cb->info;

		/* status and conn_status alias each other in the wifi_status
		 * union: 0 means success, nonzero is the wifi_conn_status
		 * failure reason.
		 */
		conn_result_status = status->status;
		k_sem_give(&conn_result_sem);
	}
}

struct saved_ssid {
	char ssid[WIFI_SSID_MAX_LEN + 1];
	size_t len;
	bool found;
};

static void pick_ssid(void *arg, const char *ssid, size_t ssid_len)
{
	struct saved_ssid *s = arg;

	if (s->found) {
		return;
	}
	s->len = MIN(ssid_len, sizeof(s->ssid) - 1);
	memcpy(s->ssid, ssid, s->len);
	s->ssid[s->len] = '\0';
	s->found = true;
}

/* One synchronous connect attempt with the stored credentials.
 *
 * @return 0 when connected, -ENOENT when no credentials are stored, another
 *         negative errno on failure (the cause is logged).
 */
static int connect_saved_once(void)
{
	struct saved_ssid s = {0};

	wifi_credentials_for_each_ssid(pick_ssid, &s);
	if (!s.found) {
		return -ENOENT;
	}

	enum wifi_security_type type;
	uint8_t bssid[WIFI_MAC_ADDR_LEN];
	char password[WIFI_CREDENTIALS_MAX_PASSWORD_LEN];
	size_t password_len = 0;
	uint32_t flags = 0;
	uint8_t channel = 0;
	uint32_t timeout = 0;

	int ret = wifi_credentials_get_by_ssid_personal(
		s.ssid, s.len, &type, bssid, sizeof(bssid), password,
		sizeof(password), &password_len, &flags, &channel, &timeout);
	if (ret != 0) {
		LOG_ERR("Failed to read stored credentials: %d", ret);
		return ret;
	}

	struct net_if *iface = net_if_get_wifi_sta();

	if (iface == NULL) {
		iface = net_if_get_first_wifi();
	}

	struct wifi_connect_req_params params = {0};

	params.ssid = (const uint8_t *)s.ssid;
	params.ssid_length = s.len;
	params.psk = (password_len > 0) ? (const uint8_t *)password : NULL;
	params.psk_length = password_len;
	params.security = type;
	params.channel = (channel > 0) ? channel : WIFI_CHANNEL_ANY;
	params.band = WIFI_FREQ_BAND_UNKNOWN;
	params.mfp = WIFI_MFP_OPTIONAL;
	params.timeout = SYS_FOREVER_MS;
	if (flags & WIFI_CREDENTIALS_FLAG_BSSID) {
		memcpy(params.bssid, bssid, WIFI_MAC_ADDR_LEN);
	}

	k_sem_reset(&conn_result_sem);

	ret = net_mgmt(NET_REQUEST_WIFI_CONNECT, iface, &params, sizeof(params));
	if (ret != 0) {
		LOG_ERR("Connect request failed: %d", ret);
		return ret;
	}

	if (k_sem_take(&conn_result_sem, SAVED_CONN_TIMEOUT) != 0) {
		LOG_WRN("Connect attempt timed out");
		return -ETIMEDOUT;
	}
	if (conn_result_status != 0) {
		LOG_WRN("Connect failed (conn_status %d)", conn_result_status);
		return -EIO;
	}
	return 0;
}

/* Try the stored credentials with backoff; true when connected. */
static bool connect_saved(void)
{
	bool connected = false;
	int backoff = 2;

	net_mgmt_init_event_callback(&conn_cb, conn_mgmt_event,
				     NET_EVENT_WIFI_CONNECT_RESULT);
	net_mgmt_add_event_callback(&conn_cb);

	for (int attempt = 1; attempt <= SAVED_CONN_ATTEMPTS; attempt++) {
		LOG_INF("Connecting with stored credentials (attempt %d/%d)",
			attempt, SAVED_CONN_ATTEMPTS);

		int ret = connect_saved_once();

		if (ret == 0) {
			LOG_INF("Wi-Fi connected (stored credentials)");
			connected = true;
			break;
		}
		if (ret == -ENOENT) {
			LOG_ERR("Stored credentials disappeared");
			break;
		}
		if (attempt < SAVED_CONN_ATTEMPTS) {
			LOG_INF("Retrying in %d s", backoff);
			k_sleep(K_SECONDS(backoff));
			backoff = MIN(backoff * 2, SAVED_CONN_BACKOFF_MAX);
		}
	}

	net_mgmt_del_event_callback(&conn_cb);
	return connected;
}

/* Run one full provisioning cycle: start the console transport, wait for
 * credentials, then stop.
 */
static int run_provisioning(void)
{
	int ret = network_prov_mgr_start_provisioning(NETWORK_PROV_SECURITY_1,
						      PROV_POP, PROV_DEVICE_NAME,
						      NULL);
	if (ret != 0) {
		LOG_ERR("Failed to start provisioning: %d", ret);
		return ret;
	}

	/* Block until the device connects with the supplied credentials. */
	network_prov_mgr_wait();

	/* The manager auto-stops the service a grace period after success
	 * (CONFIG_NETWORK_PROV_AUTOSTOP_TIMEOUT_MS), so the client still has
	 * time to poll GetWifiStatus before the transport goes away.
	 */
	LOG_INF("Provisioning complete");
	return 0;
}

int main(void)
{
	struct network_prov_mgr_config config = {
		.scheme = &network_prov_scheme_console,
		.app_event_handler = {
			.event_cb = prov_event,
			.user_data = NULL,
		},
		/* Retry transient connect failures before reporting back to
		 * the client (upstream example default).
		 */
		.wifi_conn_attempts = 5,
	};

	int ret = network_prov_mgr_init(config);

	if (ret != 0) {
		LOG_ERR("Manager init failed: %d", ret);
		return 0;
	}

	/* Advertise an application section in the proto-ver capabilities JSON
	 * (optional; lets a client negotiate app-specific features).
	 */
	static const char *const app_caps[] = {"sample"};

	/* Create a custom application endpoint (handler registered on START). */
	(void)network_prov_mgr_endpoint_create("custom-data");

	(void)network_prov_mgr_set_app_info("wifi_prov_console", "1.0", app_caps,
					    ARRAY_SIZE(app_caps));

	bool provisioned = false;

	network_prov_mgr_is_provisioned(&provisioned);

	if (provisioned) {
		LOG_INF("Device already provisioned");
		if (connect_saved()) {
			return 0;
		}
		/* The stored network stayed unreachable. Re-enter provisioning
		 * for reachability, but keep the credentials (upstream ESP-IDF
		 * policy: never erase automatically) — the next boot retries
		 * them, and a successful re-provision overwrites them.
		 */
		LOG_WRN("Stored credentials did not connect; starting "
			"provisioning (credentials kept for next boot)");
	} else {
		LOG_INF("Device not provisioned, starting console provisioning");
	}

	(void)run_provisioning();
	return 0;
}
```
