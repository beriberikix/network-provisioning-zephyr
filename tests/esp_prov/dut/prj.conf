## CMakeLists.txt
```
# SPDX-License-Identifier: Apache-2.0

cmake_minimum_required(VERSION 3.20.0)
find_package(Zephyr REQUIRED HINTS $ENV{ZEPHYR_BASE})
project(esp_prov_softap_dut)

target_sources(app PRIVATE src/main.c)
```

## prj.conf
```kconfig
# native_sim SoftAP DUT for the esp_prov integration test.
#
# SPDX-License-Identifier: Apache-2.0

# --- Provisioning manager + SoftAP transport ------------------------------
CONFIG_NETWORK_PROV_MGR=y
CONFIG_NETWORK_PROV_SOFTAP=y

# --- Fake Wi-Fi backend (no hardware on native_sim) -----------------------
CONFIG_NETWORK_PROV_FAKE_WIFI=y

# --- Networking: host-facing Ethernet TAP (zeth) + IPv4/TCP ---------------
CONFIG_NETWORKING=y
CONFIG_NET_IPV4=y
CONFIG_NET_TCP=y
CONFIG_NET_SOCKETS=y
CONFIG_NET_DRIVERS=y
CONFIG_ETH_NATIVE_TAP=y
CONFIG_NET_MGMT=y
CONFIG_NET_MGMT_EVENT=y
CONFIG_NET_MGMT_EVENT_INFO=y
CONFIG_NET_L2_WIFI_MGMT=y
# zeth (192.0.2.1) plus the SoftAP address (192.168.4.1) on the fake iface.
CONFIG_NET_IF_MAX_IPV4_COUNT=2
CONFIG_NET_MAX_CONTEXTS=16
CONFIG_NET_MAX_CONN=16
# Assign the device IP from the app, not net_config.
CONFIG_NET_CONFIG_SETTINGS=n

# DHCPv4 server the SoftAP transport starts on the (fake) AP interface.
CONFIG_NET_DHCPV4_SERVER=y

# --- HTTP server (protocomm endpoints) ------------------------------------
CONFIG_HTTP_SERVER=y
CONFIG_ZVFS_EVENTFD_MAX=2
CONFIG_HTTP_SERVER_CAPTURE_HEADERS=y
CONFIG_HTTP_SERVER_MAX_CLIENTS=3
CONFIG_ZVFS_POLL_MAX=8
CONFIG_HTTP_SERVER_CLIENT_BUFFER_SIZE=1024
CONFIG_HTTP_SERVER_STACK_SIZE=8192

# --- Credential storage (native_sim sim-flash has a storage_partition) ----
CONFIG_WIFI_CREDENTIALS=y
CONFIG_WIFI_CREDENTIALS_BACKEND_SETTINGS=y
CONFIG_SETTINGS=y
CONFIG_FLASH=y
CONFIG_FLASH_MAP=y
CONFIG_NVS=y
CONFIG_SETTINGS_NVS=y

# --- Crypto: PSA (mbedTLS) for security scheme 1 --------------------------
CONFIG_PSA_CRYPTO=y
CONFIG_MBEDTLS=y
CONFIG_MBEDTLS_PSA_CRYPTO_C=y
CONFIG_MBEDTLS_ENABLE_HEAP=y
CONFIG_MBEDTLS_HEAP_SIZE=16384
CONFIG_ENTROPY_GENERATOR=y
CONFIG_PSA_WANT_ALG_ECDH=y
CONFIG_PSA_WANT_ECC_MONTGOMERY_255=y
CONFIG_PSA_WANT_KEY_TYPE_ECC_KEY_PAIR_GENERATE=y
CONFIG_PSA_WANT_KEY_TYPE_ECC_KEY_PAIR_EXPORT=y
CONFIG_PSA_WANT_KEY_TYPE_ECC_KEY_PAIR_DERIVE=y
CONFIG_PSA_WANT_ALG_CTR=y
CONFIG_PSA_WANT_KEY_TYPE_AES=y
CONFIG_PSA_WANT_ALG_SHA_256=y

# --- Protobuf -------------------------------------------------------------
CONFIG_NANOPB=y

# --- Runtime resources ----------------------------------------------------
CONFIG_HEAP_MEM_POOL_SIZE=32768
CONFIG_MAIN_STACK_SIZE=4096
CONFIG_SYSTEM_WORKQUEUE_STACK_SIZE=4096

# --- Logging --------------------------------------------------------------
CONFIG_LOG=y
CONFIG_PRINTK=y
```

## src/main.c
```c
/*
 * native_sim DUT for the esp_prov SoftAP integration test.
 *
 * Runs the real provisioning manager over the SoftAP (HTTP) transport, backed
 * by the fake Wi-Fi driver, and stays in provisioning mode so the host-side
 * esp_prov tool can drive multiple scenarios. The HTTP server binds to all
 * interfaces, so it is reachable from the host over the native_sim "zeth"
 * Ethernet TAP at a fixed IP.
 *
 * The fake Wi-Fi backend runs in credential-matching mode: esp_prov drives the
 * outcome purely through the SSID/passphrase it sends — the right passphrase
 * for HOST_SSID succeeds, a wrong one reports WRONG_PASSWORD, and an SSID that
 * is not in the canned scan list reports AP_NOT_FOUND.
 *
 * SPDX-License-Identifier: Apache-2.0
 */

#include <string.h>
#include <errno.h>
#include <zephyr/kernel.h>
#include <zephyr/logging/log.h>
#include <zephyr/net/net_if.h>
#include <zephyr/net/ethernet.h>
#include <zephyr/net/wifi.h>

#include "network_provisioning/network_prov_mgr.h"
#include "network_provisioning/scheme_softap.h"
#include "network_provisioning/test/fake_wifi.h"

LOG_MODULE_REGISTER(esp_prov_dut, LOG_LEVEL_INF);

/* Echo handler for the custom endpoint: returns "echo:" + request, exercising
 * the SoftAP custom-endpoint route (esp_prov --custom_data).
 */
static int custom_echo(void *ctx, const uint8_t *inbuf, size_t inlen,
		       uint8_t **outbuf, size_t *outlen)
{
	ARG_UNUSED(ctx);
	static const char prefix[] = "echo:";
	size_t plen = sizeof(prefix) - 1;
	uint8_t *out = k_malloc(plen + inlen);

	if (out == NULL) {
		return -ENOMEM;
	}
	memcpy(out, prefix, plen);
	memcpy(out + plen, inbuf, inlen);
	*outbuf = out;
	*outlen = plen + inlen;
	return 0;
}

#define PROV_POP   "abcd1234"
#define AP_NAME    "PROV_ZEPHYR"

/* The one "real" network esp_prov can successfully provision. */
#define HOST_SSID  "HomeNet"
#define HOST_PASS  "correct-horse-battery"

/* Device address on the host-facing Ethernet TAP (host side is 192.0.2.2,
 * configured by net-tools' net-setup.sh).
 */
#define DUT_IP     "192.0.2.1"
#define DUT_NETMASK "255.255.255.0"

/* Assign the fixed device IP to the host-facing Ethernet interface — the one
 * that is Ethernet-L2 but NOT the fake Wi-Fi interface (which also uses
 * Ethernet L2). esp_prov connects to this address.
 */
static void assign_host_ip(struct net_if *iface, void *user_data)
{
	struct net_if **out = user_data;
	struct in_addr addr;
	struct in_addr netmask;

	if (*out != NULL || net_if_is_wifi(iface)) {
		return;
	}
	if (net_if_l2(iface) != &NET_L2_GET_NAME(ETHERNET)) {
		return;
	}

	if (net_addr_pton(AF_INET, DUT_IP, &addr) != 0 ||
	    net_addr_pton(AF_INET, DUT_NETMASK, &netmask) != 0) {
		return;
	}
	if (net_if_ipv4_addr_add(iface, &addr, NET_ADDR_MANUAL, 0) == NULL) {
		LOG_WRN("could not add %s to the host interface", DUT_IP);
	}
	net_if_ipv4_set_netmask_by_addr(iface, &addr, &netmask);
	net_if_up(iface);
	*out = iface;
}

static void program_fake_wifi(void)
{
	const struct fake_wifi_ap aps[] = {
		{ .ssid = HOST_SSID, .ssid_len = sizeof(HOST_SSID) - 1,
		  .channel = 6, .rssi = -42, .security = WIFI_SECURITY_TYPE_PSK,
		  .bssid = {0x00, 0x11, 0x22, 0x33, 0x44, 0x55} },
		{ .ssid = "OpenCafe", .ssid_len = 8, .channel = 11, .rssi = -75,
		  .security = WIFI_SECURITY_TYPE_NONE,
		  .bssid = {0xaa, 0xbb, 0xcc, 0xdd, 0xee, 0xff} },
	};

	fake_wifi_set_scan_aps(aps, ARRAY_SIZE(aps));
	fake_wifi_set_expected_credentials(HOST_SSID, HOST_PASS);
}

int main(void)
{
	struct net_if *host = NULL;

	net_if_foreach(assign_host_ip, &host);
	if (host != NULL) {
		LOG_INF("host interface up at %s", DUT_IP);
	} else {
		LOG_WRN("no host Ethernet interface found");
	}

	program_fake_wifi();

	struct network_prov_mgr_config cfg = {
		.scheme = &network_prov_scheme_softap,
		.wifi_conn_attempts = 0, /* single attempt: report failures at once */
	};

	if (network_prov_mgr_init(cfg) != 0) {
		LOG_ERR("manager init failed");
		return 1;
	}
	/* Keep the service up across all esp_prov scenarios (the test drives
	 * success and several failures against one long-running instance).
	 */
	(void)network_prov_mgr_disable_auto_stop(0);
	/* A custom application endpoint, reached over SoftAP via the fallback
	 * route (esp_prov --custom_data); register the handler after start.
	 */
	(void)network_prov_mgr_endpoint_create("custom-data");
	if (network_prov_mgr_start_provisioning(NETWORK_PROV_SECURITY_1, PROV_POP,
						AP_NAME, NULL) != 0) {
		LOG_ERR("start_provisioning failed");
		return 1;
	}
	(void)network_prov_mgr_endpoint_register("custom-data", custom_echo, NULL);

	LOG_INF("esp_prov DUT ready: provisioning over HTTP at %s:80", DUT_IP);

	/* Stay up so esp_prov can run the success and failure scenarios. */
	while (true) {
		k_sleep(K_SECONDS(1));
	}
	return 0;
}
```
