## CMakeLists.txt
```
# SPDX-License-Identifier: Apache-2.0

cmake_minimum_required(VERSION 3.20.0)
find_package(Zephyr REQUIRED HINTS $ENV{ZEPHYR_BASE})
project(network_provisioning_bsim_thread_e2e)

target_sources(app PRIVATE
  src/main.c
  src/dut.c
  src/peer.c
  src/common.c
)

# Internal module headers (network_prov_internal.h) and the nanopb-generated
# *.pb.h headers from the module's build directory.
target_include_directories(app PRIVATE
  ${ZEPHYR_NETWORK_PROVISIONING_MODULE_DIR}/src
  ${CMAKE_BINARY_DIR}/modules/network_provisioning/proto
)

# babblesim test-case helpers (TEST_PASS/TEST_FAIL, bst_test).
add_subdirectory(${ZEPHYR_BASE}/tests/bsim/babblekit babblekit)
target_link_libraries(app PRIVATE babblekit)

zephyr_include_directories(
  ${BSIM_COMPONENTS_PATH}/libUtilv1/src/
  ${BSIM_COMPONENTS_PATH}/libPhyComv1/src/
)
```

## prj.conf
```kconfig
# Thread provisioning BabbleSim E2E: the manager (Thread network type) + real
# OpenThread on the simulated nrf52_bsim 802.15.4 radio. No BLE — the handlers
# are driven directly (the BLE transport is covered by ble_e2e).
#
# SPDX-License-Identifier: Apache-2.0

# --- Provisioning manager (Thread) ----------------------------------------
CONFIG_NETWORK_PROV_MGR=y
# Cheapest transport to satisfy the ">=1 transport" requirement; never started.
CONFIG_NETWORK_PROV_CONSOLE=y
CONFIG_NETWORK_PROV_NETWORK_TYPE_THREAD=y
CONFIG_SHELL=y
CONFIG_SHELL_BACKEND_SERIAL=n

# --- OpenThread (FTD) over the nrf52_bsim 802.15.4 radio ------------------
CONFIG_NETWORKING=y
CONFIG_NET_IPV6=y
CONFIG_NET_TCP=n
CONFIG_NET_IPV4=n
CONFIG_NET_L2_OPENTHREAD=y
CONFIG_OPENTHREAD_FTD=y
# The app provisions/forms the network itself; don't auto-start with defaults.
CONFIG_OPENTHREAD_MANUAL_START=y
CONFIG_OPENTHREAD_LOG_LEVEL_INFO=y

# --- Dataset persistence (OpenThread settings backend) --------------------
CONFIG_SETTINGS=y
CONFIG_FLASH=y
CONFIG_FLASH_MAP=y
CONFIG_NVS=y
CONFIG_SETTINGS_NVS=y

# --- Crypto (security scheme 1; NETWORK_PROV_CORE depends on PSA_CRYPTO) ------
CONFIG_PSA_CRYPTO=y
CONFIG_MBEDTLS=y
CONFIG_MBEDTLS_PSA_CRYPTO_C=y
CONFIG_MBEDTLS_ENABLE_HEAP=y
CONFIG_MBEDTLS_HEAP_SIZE=16384
CONFIG_ENTROPY_GENERATOR=y
CONFIG_PSA_WANT_ALG_ECDH=y
CONFIG_PSA_WANT_ECC_MONTGOMERY_255=y
CONFIG_PSA_WANT_KEY_TYPE_ECC_KEY_PAIR_GENERATE=y
CONFIG_PSA_WANT_KEY_TYPE_ECC_KEY_PAIR_EXPORT=y
CONFIG_PSA_WANT_KEY_TYPE_ECC_KEY_PAIR_DERIVE=y
CONFIG_PSA_WANT_ALG_CTR=y
CONFIG_PSA_WANT_KEY_TYPE_AES=y
CONFIG_PSA_WANT_ALG_SHA_256=y

CONFIG_NANOPB=y

CONFIG_HEAP_MEM_POOL_SIZE=16384
CONFIG_MAIN_STACK_SIZE=4096
CONFIG_SYSTEM_WORKQUEUE_STACK_SIZE=4096
CONFIG_LOG=y
```

## src/main.c
```c
/*
 * BabbleSim end-to-end test for Thread provisioning over a simulated 802.15.4
 * radio (no BLE — the BLE transport is covered by ble_e2e).
 *
 * dut_attach (1 node): the manager's Thread config handler applies a dataset
 * and the node attaches (forms its own network → leader) → CRED_SUCCESS.
 * dut_scan (2 nodes): a "peer" node forms a known network and the DUT's Thread
 * scan handler discovers it via otThreadDiscover.
 *
 * SPDX-License-Identifier: Apache-2.0
 */

#include "bstests.h"

extern struct bst_test_list *dut_install(struct bst_test_list *tests);
extern struct bst_test_list *peer_install(struct bst_test_list *tests);

bst_test_install_t test_installers[] = {
	dut_install,
	peer_install,
	NULL,
};

int main(void)
{
	bst_main();
	return 0;
}
```

## src/common.c
```c
/*
 * Shared dataset builder for the Thread provisioning BabbleSim E2E.
 *
 * SPDX-License-Identifier: Apache-2.0
 */

#include <string.h>

#include <openthread.h>
#include <openthread/dataset.h>
#include <openthread/dataset_ftd.h>

#include "common.h"

int build_peer_dataset(otOperationalDatasetTlvs *out)
{
	/* Caller holds the OpenThread mutex. */
	otInstance *inst = openthread_get_default_instance();
	otOperationalDataset ds;

	if (otDatasetCreateNewNetwork(inst, &ds) != OT_ERROR_NONE) {
		return -1;
	}

	/* Override the name and channel with known values so the DUT can scan the
	 * right channel and assert on the discovered network name.
	 */
	memset(ds.mNetworkName.m8, 0, sizeof(ds.mNetworkName.m8));
	strncpy(ds.mNetworkName.m8, PEER_NET_NAME, sizeof(ds.mNetworkName.m8) - 1);
	ds.mComponents.mIsNetworkNamePresent = true;
	ds.mChannel = PEER_CHANNEL;
	ds.mComponents.mIsChannelPresent = true;

	otDatasetConvertToTlvs(&ds, out);
	return 0;
}
```

## src/common.h
```c
/*
 * Shared constants/helpers for the Thread provisioning BabbleSim E2E.
 *
 * SPDX-License-Identifier: Apache-2.0
 */

#ifndef NETWORK_PROV_BSIM_THREAD_COMMON_H_
#define NETWORK_PROV_BSIM_THREAD_COMMON_H_

#include <openthread/dataset.h>

/* The network the peer node forms and the DUT scan must discover. */
#define PEER_NET_NAME "ot-e2e-net"
#define PEER_CHANNEL  20

/* Build a complete Active Operational Dataset with a known network name and
 * channel (random key/PAN/ext-PAN), serialised to TLVs. Used by the peer to
 * form the discoverable network. Returns 0 on success.
 */
int build_peer_dataset(otOperationalDatasetTlvs *out);

#endif /* NETWORK_PROV_BSIM_THREAD_COMMON_H_ */
```

## src/dut.c
```c
/*
 * DUT: the real provisioning manager (Thread network type). Two scenarios:
 *
 *  - dut_attach: apply a freshly generated dataset via the Thread config
 *    handler; a lone FTD forms its own network and becomes leader, so the
 *    manager reports NETWORK_PROV_CRED_SUCCESS.
 *  - dut_scan: drive the Thread scan handler (otThreadDiscover) and assert the
 *    peer node's network is discovered.
 *
 * The manager is init'd (console scheme — satisfies the >=1-transport guard,
 * never started) so its event/semaphore plumbing is live; the handlers are
 * invoked directly (no transport client).
 *
 * SPDX-License-Identifier: Apache-2.0
 */

#include <string.h>
#include <zephyr/kernel.h>

#include "bstests.h"
#include "babblekit/testcase.h"

#include <openthread.h>
#include <openthread/dataset.h>
#include <openthread/dataset_ftd.h>
#include <openthread/instance.h>

#include <pb_encode.h>
#include <pb_decode.h>
#include "network_scan.pb.h"

#include "network_provisioning/network_prov_mgr.h"
#include "network_provisioning/scheme_console.h"
#include "network_prov_internal.h"

#include "common.h"

#define WAIT_TIME_S 40
#define WAIT_TIME   (WAIT_TIME_S * 1e6)

static void prov_event(void *user_data, enum network_prov_cb_event event, void *event_data)
{
	ARG_UNUSED(user_data);
	ARG_UNUSED(event_data);

	switch (event) {
	case NETWORK_PROV_CRED_RECV:
		TEST_PRINT("DUT: dataset received, attaching...");
		break;
	case NETWORK_PROV_CRED_SUCCESS:
		TEST_PASS("DUT: Thread attached");
		break;
	case NETWORK_PROV_CRED_FAIL:
		TEST_FAIL("DUT: Thread attach failed");
		break;
	default:
		break;
	}
}

static void dut_init_mgr(void)
{
	struct network_prov_mgr_config cfg = {
		.scheme = &network_prov_scheme_console,
		.app_event_handler = { .event_cb = prov_event },
	};

	TEST_ASSERT(network_prov_mgr_init(cfg) == 0, "manager init failed");
}

static void dut_attach_main(void)
{
	otOperationalDataset ds;
	otOperationalDatasetTlvs tlvs;
	otError err;

	dut_init_mgr();
	/* Initialise the config handler (registers the OpenThread state-changed
	 * callback and the attach-timeout work) — start_provisioning would do this
	 * via net_endpoints_init(), but this test drives the handler directly.
	 */
	TEST_ASSERT(network_prov_thread_config_init() == 0, "thread config init failed");

	openthread_mutex_lock();
	err = otDatasetCreateNewNetwork(openthread_get_default_instance(), &ds);
	if (err == OT_ERROR_NONE) {
		otDatasetConvertToTlvs(&ds, &tlvs);
	}
	openthread_mutex_unlock();
	TEST_ASSERT(err == OT_ERROR_NONE, "dataset create failed: %d", err);

	/* Applies the dataset, enables Thread; the verdict is set in prov_event()
	 * once the node attaches (forms its own network → leader).
	 */
	TEST_ASSERT(network_prov_thread_config_set_and_apply(tlvs.mTlvs, tlvs.mLength) == 0,
		    "apply failed");
}

/* Encode a NetworkScanPayload, run the Thread scan handler, decode the
 * response. Returns the handler's return code.
 */
static int run_scan(const NetworkScanPayload *req, NetworkScanPayload *resp)
{
	uint8_t buf[64];
	pb_ostream_t os = pb_ostream_from_buffer(buf, sizeof(buf));

	TEST_ASSERT(pb_encode(&os, NetworkScanPayload_fields, req), "encode failed: %s",
		    PB_GET_ERROR(&os));

	uint8_t *out = NULL;
	size_t outlen = 0;
	int ret = network_prov_thread_scan_handler(NULL, buf, os.bytes_written, &out, &outlen);

	if (ret != 0) {
		return ret;
	}

	pb_istream_t is = pb_istream_from_buffer(out, outlen);

	TEST_ASSERT(pb_decode(&is, NetworkScanPayload_fields, resp), "decode failed: %s",
		    PB_GET_ERROR(&is));
	k_free(out);
	return 0;
}

static void dut_scan_main(void)
{
	dut_init_mgr();
	TEST_ASSERT(network_prov_thread_scan_init() == 0, "scan init failed");

	/* Let the peer form its network first. */
	k_sleep(K_SECONDS(5));

	/* Blocking discovery on the peer's channel. */
	NetworkScanPayload req = NetworkScanPayload_init_default;
	NetworkScanPayload resp = NetworkScanPayload_init_default;

	req.msg = NetworkScanMsgType_TypeCmdScanThreadStart;
	req.which_payload = NetworkScanPayload_cmd_scan_thread_start_tag;
	req.payload.cmd_scan_thread_start.blocking = true;
	req.payload.cmd_scan_thread_start.channel_mask = BIT(PEER_CHANNEL);

	TEST_ASSERT(run_scan(&req, &resp) == 0, "scan start failed");
	TEST_ASSERT(resp.msg == NetworkScanMsgType_TypeRespScanThreadStart,
		    "unexpected scan-start resp msg %d", resp.msg);
	/* RespScanThreadStart is empty; the start status is the top-level field. */
	TEST_ASSERT(resp.status == Status_Success, "scan start status %d", resp.status);

	/* Pull the results and look for the peer's network. */
	req = (NetworkScanPayload)NetworkScanPayload_init_default;
	resp = (NetworkScanPayload)NetworkScanPayload_init_default;
	req.msg = NetworkScanMsgType_TypeCmdScanThreadResult;
	req.which_payload = NetworkScanPayload_cmd_scan_thread_result_tag;
	req.payload.cmd_scan_thread_result.start_index = 0;
	req.payload.cmd_scan_thread_result.count = 4;

	TEST_ASSERT(run_scan(&req, &resp) == 0, "scan result failed");

	RespScanThreadResult *r = &resp.payload.resp_scan_thread_result;
	bool found = false;

	for (size_t i = 0; i < r->entries_count; i++) {
		TEST_PRINT("DUT: discovered '%s' (pan 0x%04x, ch %u)",
			   r->entries[i].network_name, r->entries[i].pan_id,
			   r->entries[i].channel);
		if (strcmp(r->entries[i].network_name, PEER_NET_NAME) == 0) {
			found = true;
		}
	}

	if (found) {
		TEST_PASS("DUT: discovered peer network '%s'", PEER_NET_NAME);
	} else {
		TEST_FAIL("DUT: peer network '%s' not found (%u result(s))",
			  PEER_NET_NAME, (unsigned int)r->entries_count);
	}
}

static void dut_tick(bs_time_t HW_device_time)
{
	ARG_UNUSED(HW_device_time);
	if (bst_result != Passed) {
		TEST_FAIL("DUT: test did not pass within %d seconds", WAIT_TIME_S);
	}
}

static void dut_init(void)
{
	bst_ticker_set_next_tick_absolute(WAIT_TIME);
	bst_result = In_progress;
}

static const struct bst_test_instance dut_tests[] = {
	{
		.test_id = "dut_attach",
		.test_descr = "Apply a dataset and attach (form network as leader)",
		.test_pre_init_f = dut_init,
		.test_tick_f = dut_tick,
		.test_main_f = dut_attach_main,
	},
	{
		.test_id = "dut_scan",
		.test_descr = "Discover the peer's Thread network via otThreadDiscover",
		.test_pre_init_f = dut_init,
		.test_tick_f = dut_tick,
		.test_main_f = dut_scan_main,
	},
	BSTEST_END_MARKER,
};

struct bst_test_list *dut_install(struct bst_test_list *tests)
{
	return bst_add_tests(tests, dut_tests);
}
```

## src/peer.c
```c
/*
 * Peer (device 1) for the dut_scan scenario: a plain OpenThread FTD (no
 * provisioning manager) that forms a known Thread network and stays up so the
 * DUT's otThreadDiscover finds it.
 *
 * SPDX-License-Identifier: Apache-2.0
 */

#include <zephyr/kernel.h>

#include "bstests.h"
#include "babblekit/testcase.h"

#include <openthread.h>
#include <openthread/dataset.h>
#include <openthread/instance.h>
#include <openthread/ip6.h>
#include <openthread/thread.h>

#include "common.h"

#define WAIT_TIME_S 40
#define WAIT_TIME   (WAIT_TIME_S * 1e6)

static struct openthread_state_changed_callback peer_cb;

static void peer_state(otChangedFlags flags, void *context)
{
	ARG_UNUSED(context);

	if ((flags & OT_CHANGED_THREAD_ROLE) == 0) {
		return;
	}

	otDeviceRole role = otThreadGetDeviceRole(openthread_get_default_instance());

	TEST_PRINT("peer: role -> %d", role);
	if (role == OT_DEVICE_ROLE_LEADER && bst_result != Passed) {
		/* Network formed. Pass, but keep running (OpenThread continues under
		 * the bsim scheduler) so the DUT's discovery gets a response.
		 */
		TEST_PASS("peer: formed network '%s' (leader)", PEER_NET_NAME);
	}
}

static void peer_main(void)
{
	otInstance *inst = openthread_get_default_instance();
	otOperationalDatasetTlvs tlvs;
	int rc;

	/* Register the role callback before enabling, so a fast leader transition
	 * is not missed.
	 */
	peer_cb.otCallback = peer_state;
	TEST_ASSERT(openthread_state_changed_callback_register(&peer_cb) == 0,
		    "peer: state callback register failed");

	openthread_mutex_lock();
	rc = build_peer_dataset(&tlvs);
	if (rc == 0) {
		(void)otDatasetSetActiveTlvs(inst, &tlvs);
		(void)otIp6SetEnabled(inst, true);
		(void)otThreadSetEnabled(inst, true);
	}
	openthread_mutex_unlock();

	TEST_ASSERT(rc == 0, "peer: failed to build dataset");
	/* Return; the verdict is set in peer_state() once we become leader. */
}

static void peer_tick(bs_time_t HW_device_time)
{
	ARG_UNUSED(HW_device_time);
	if (bst_result != Passed) {
		TEST_FAIL("peer: never became leader within %d seconds", WAIT_TIME_S);
	}
}

static void peer_init(void)
{
	bst_ticker_set_next_tick_absolute(WAIT_TIME);
	bst_result = In_progress;
}

static const struct bst_test_instance peer_tests[] = {
	{
		.test_id = "peer",
		.test_descr = "OpenThread FTD that forms a discoverable network",
		.test_pre_init_f = peer_init,
		.test_tick_f = peer_tick,
		.test_main_f = peer_main,
	},
	BSTEST_END_MARKER,
};

struct bst_test_list *peer_install(struct bst_test_list *tests)
{
	return bst_add_tests(tests, peer_tests);
}
```
