## CMakeLists.txt
```
# SPDX-License-Identifier: Apache-2.0

cmake_minimum_required(VERSION 3.20.0)
find_package(Zephyr REQUIRED HINTS $ENV{ZEPHYR_BASE})
project(network_provisioning_bsim_ble_e2e)

target_sources(app PRIVATE
  src/main.c
  src/dut.c
  src/tester.c
  ${ZEPHYR_NETWORK_PROVISIONING_MODULE_DIR}/tests/common/prov_client.c
)

# Internal module headers (protocomm.h), the shared sec1 client and the
# nanopb-generated *.pb.h headers from the module's build directory.
target_include_directories(app PRIVATE
  ${ZEPHYR_NETWORK_PROVISIONING_MODULE_DIR}/src
  ${ZEPHYR_NETWORK_PROVISIONING_MODULE_DIR}/tests/common
  ${CMAKE_BINARY_DIR}/modules/network_provisioning/proto
)

# Synchronous GATT/scan/connect helpers used by the tester.
add_subdirectory(${ZEPHYR_BASE}/tests/bluetooth/common/testlib testlib)
target_link_libraries(app PRIVATE testlib)

# babblesim test-case helpers (TEST_PASS/TEST_FAIL, bst_test).
add_subdirectory(${ZEPHYR_BASE}/tests/bsim/babblekit babblekit)
target_link_libraries(app PRIVATE babblekit)

zephyr_include_directories(
  ${BSIM_COMPONENTS_PATH}/libUtilv1/src/
  ${BSIM_COMPONENTS_PATH}/libPhyComv1/src/
)
```

## prj.conf
```kconfig
# BabbleSim BLE end-to-end provisioning test (one image, two roles).
#
# SPDX-License-Identifier: Apache-2.0

# --- Bluetooth: the DUT is a peripheral, the tester a central -------------
CONFIG_BT=y
CONFIG_BT_PERIPHERAL=y
CONFIG_BT_CENTRAL=y
CONFIG_BT_GATT_CLIENT=y
CONFIG_BT_GATT_DYNAMIC_DB=y
CONFIG_BT_DEVICE_NAME="PROV_BSIM"
CONFIG_BT_DEVICE_NAME_DYNAMIC=y
CONFIG_BT_DEVICE_NAME_MAX=32
CONFIG_BT_BUF_ACL_TX_SIZE=502
CONFIG_BT_BUF_ACL_RX_SIZE=502
CONFIG_BT_L2CAP_TX_MTU=498
CONFIG_BT_ATT_PREPARE_COUNT=4
# sec1 PSA crypto runs on the BT RX thread via the GATT callbacks.
CONFIG_BT_RX_STACK_SIZE=4096

# --- Provisioning manager + BLE transport ---------------------------------
CONFIG_NETWORK_PROV_MGR=y
CONFIG_NETWORK_PROV_BLE=y

# --- Fake Wi-Fi backend (no hardware on nrf52_bsim) -----------------------
CONFIG_NETWORK_PROV_FAKE_WIFI=y
CONFIG_NETWORKING=y
CONFIG_NET_IPV4=y
CONFIG_NET_MGMT=y
CONFIG_NET_MGMT_EVENT=y
CONFIG_NET_MGMT_EVENT_INFO=y

# --- Credential storage (nrf52_bsim models the nRF flash) -----------------
CONFIG_WIFI_CREDENTIALS=y
CONFIG_WIFI_CREDENTIALS_BACKEND_SETTINGS=y
CONFIG_SETTINGS=y
CONFIG_FLASH=y
CONFIG_FLASH_MAP=y
CONFIG_NVS=y

# --- Crypto: PSA (mbedTLS) for security scheme 1 --------------------------
CONFIG_PSA_CRYPTO=y
CONFIG_MBEDTLS=y
CONFIG_MBEDTLS_PSA_CRYPTO_C=y
CONFIG_MBEDTLS_ENABLE_HEAP=y
CONFIG_MBEDTLS_HEAP_SIZE=16384
CONFIG_ENTROPY_GENERATOR=y
CONFIG_PSA_WANT_ALG_ECDH=y
CONFIG_PSA_WANT_ECC_MONTGOMERY_255=y
CONFIG_PSA_WANT_KEY_TYPE_ECC_KEY_PAIR_GENERATE=y
CONFIG_PSA_WANT_KEY_TYPE_ECC_KEY_PAIR_EXPORT=y
CONFIG_PSA_WANT_KEY_TYPE_ECC_KEY_PAIR_DERIVE=y
CONFIG_PSA_WANT_ALG_CTR=y
CONFIG_PSA_WANT_KEY_TYPE_AES=y
CONFIG_PSA_WANT_ALG_SHA_256=y

# --- Protobuf -------------------------------------------------------------
CONFIG_NANOPB=y

# --- Runtime resources ----------------------------------------------------
CONFIG_HEAP_MEM_POOL_SIZE=32768
CONFIG_MAIN_STACK_SIZE=8192
CONFIG_SYSTEM_WORKQUEUE_STACK_SIZE=4096

# --- bsim uses the bst_test harness, not ztest ----------------------------
CONFIG_LOG=y
```

## src/main.c
```c
/*
 * BabbleSim end-to-end test for the BLE provisioning transport.
 *
 * Device 0 (DUT) runs the real provisioning manager over the real BLE GATT
 * transport, backed by the fake Wi-Fi driver. Device 1 (tester) is a GATT
 * central that drives a full provisioning flow (sec1 handshake, scan, config,
 * status) against it. Two simulations are run: a successful provisioning and a
 * wrong-password failure injection.
 *
 * SPDX-License-Identifier: Apache-2.0
 */

#include "bstests.h"

extern struct bst_test_list *dut_install(struct bst_test_list *tests);
extern struct bst_test_list *tester_install(struct bst_test_list *tests);

bst_test_install_t test_installers[] = {
	dut_install,
	tester_install,
	NULL,
};

int main(void)
{
	bst_main();
	return 0;
}
```

## src/common.h
```c
/*
 * Shared constants for the BLE provisioning BabbleSim test.
 *
 * SPDX-License-Identifier: Apache-2.0
 */

#ifndef NETWORK_PROV_BSIM_BLE_E2E_COMMON_H_
#define NETWORK_PROV_BSIM_BLE_E2E_COMMON_H_

#include <zephyr/bluetooth/uuid.h> /* BT_UUID_128_ENCODE for PROV_TEST_SVC_UUID */

/* BLE device name the DUT advertises and the tester scans for. */
#define PROV_TEST_NAME "PROV_BSIM"

/* Proof-of-possession both sides use for the security-1 handshake. */
#define PROV_TEST_POP "abcd1234"

/* The SSID the tester provisions; matches a canned AP the DUT advertises. */
#define PROV_TEST_SSID "HomeNet"
#define PROV_TEST_PASS "supersecret123"

/* Custom 128-bit GATT service UUID the DUT installs via
 * network_prov_scheme_ble_set_service_uuid(); the tester discovers by it, so a
 * successful discovery proves the override took effect.
 */
#define PROV_TEST_SVC_UUID \
	BT_UUID_128_ENCODE(0x1234abcd, 0x1111, 0x2222, 0x3333, 0x444455556666)

/* Manufacturer-specific data the DUT advertises (company id 0x02E5 + payload);
 * the tester verifies it appears in the scan response.
 */
#define PROV_TEST_MFG_DATA {0xE5, 0x02, 0xCA, 0xFE}

/* Application section the DUT injects into proto-ver via set_app_info(). */
#define PROV_TEST_APP_LABEL "bsimapp"
#define PROV_TEST_APP_VER   "9.9"
#define PROV_TEST_APP_CAP   "feat_x"

/* Custom application endpoint (network_prov_mgr_endpoint_create/register): the
 * DUT echoes "echo:<msg>"; the tester verifies the round-trip over the secure
 * session.
 */
#define PROV_TEST_CUSTOM_EP  "custom-data"
#define PROV_TEST_CUSTOM_MSG "ping123"

#endif /* NETWORK_PROV_BSIM_BLE_E2E_COMMON_H_ */
```

## src/dut.c
```c
/*
 * DUT (device 0): the real provisioning manager + BLE GATT transport + fake
 * Wi-Fi backend. It programs the Wi-Fi outcome, starts BLE provisioning and
 * waits for the tester to drive it, passing when the manager reports the
 * expected credential result.
 *
 * SPDX-License-Identifier: Apache-2.0
 */

#include <string.h>
#include <errno.h>
#include <zephyr/kernel.h>
#include <zephyr/bluetooth/bluetooth.h>

#include "babblekit/testcase.h"

#include "network_provisioning/network_prov_mgr.h"
#include "network_provisioning/scheme_ble.h"
#include "network_provisioning/test/fake_wifi.h"

#include "common.h"

#define WAIT_TIME_S 30
#define WAIT_TIME   (WAIT_TIME_S * 1e6)

/* The credential event the DUT expects for the running scenario. */
static enum network_prov_cb_event expected_event;

static void prov_event(void *user_data, enum network_prov_cb_event event, void *event_data)
{
	ARG_UNUSED(user_data);
	ARG_UNUSED(event_data);

	switch (event) {
	case NETWORK_PROV_START:
		TEST_PRINT("DUT: provisioning started (advertising)");
		break;
	case NETWORK_PROV_CRED_RECV:
		TEST_PRINT("DUT: credentials received");
		break;
	case NETWORK_PROV_CRED_SUCCESS:
	case NETWORK_PROV_CRED_FAIL:
		if (event == expected_event) {
			TEST_PASS("DUT: got expected credential result (%d)", event);
		} else {
			TEST_FAIL("DUT: unexpected credential result %d (wanted %d)",
				  event, expected_event);
		}
		break;
	default:
		break;
	}
}

/* Echo handler for the custom endpoint: returns "echo:" + request. */
static int custom_echo(void *ctx, const uint8_t *inbuf, size_t inlen,
		       uint8_t **outbuf, size_t *outlen)
{
	ARG_UNUSED(ctx);
	static const char prefix[] = "echo:";
	size_t plen = sizeof(prefix) - 1;
	uint8_t *out = k_malloc(plen + inlen);

	if (out == NULL) {
		return -ENOMEM;
	}
	memcpy(out, prefix, plen);
	memcpy(out + plen, inbuf, inlen);
	*outbuf = out;
	*outlen = plen + inlen;
	return 0;
}

static void canned_scan_list(void)
{
	const struct fake_wifi_ap aps[] = {
		{ .ssid = PROV_TEST_SSID, .ssid_len = sizeof(PROV_TEST_SSID) - 1,
		  .channel = 6, .rssi = -42, .security = WIFI_SECURITY_TYPE_PSK,
		  .bssid = {0x00, 0x11, 0x22, 0x33, 0x44, 0x55} },
		{ .ssid = "OpenCafe", .ssid_len = 8, .channel = 11, .rssi = -75,
		  .security = WIFI_SECURITY_TYPE_NONE,
		  .bssid = {0xaa, 0xbb, 0xcc, 0xdd, 0xee, 0xff} },
	};

	fake_wifi_set_scan_aps(aps, ARRAY_SIZE(aps));
}

static void dut_run(enum wifi_conn_status connect_outcome,
		    enum network_prov_cb_event want)
{
	struct network_prov_mgr_config cfg = {
		.scheme = &network_prov_scheme_ble,
		.app_event_handler = { .event_cb = prov_event },
		.wifi_conn_attempts = 0, /* single attempt: failures reported at once */
	};

	expected_event = want;

	fake_wifi_reset();
	canned_scan_list();
	fake_wifi_set_next_connect_result(connect_outcome);

	TEST_ASSERT(network_prov_mgr_init(cfg) == 0, "manager init failed");

	/* Tier-1 parity APIs under test: a custom BLE service UUID + mfg data
	 * (the tester verifies both) and an app-info section in proto-ver.
	 */
	static const uint8_t svc_uuid[16] = {PROV_TEST_SVC_UUID};
	static const uint8_t mfg[] = PROV_TEST_MFG_DATA;
	static const char *const app_caps[] = {PROV_TEST_APP_CAP};

	TEST_ASSERT(network_prov_scheme_ble_set_service_uuid(svc_uuid) == 0,
		    "set_service_uuid failed");
	TEST_ASSERT(network_prov_scheme_ble_set_mfg_data(mfg, sizeof(mfg)) == 0,
		    "set_mfg_data failed");
	TEST_ASSERT(network_prov_mgr_set_app_info(PROV_TEST_APP_LABEL, PROV_TEST_APP_VER,
						  app_caps, ARRAY_SIZE(app_caps)) == 0,
		    "set_app_info failed");

	/* Custom application endpoint (D1): created before start so it gets a
	 * GATT characteristic, handler registered after start.
	 */
	TEST_ASSERT(network_prov_mgr_endpoint_create(PROV_TEST_CUSTOM_EP) == 0,
		    "endpoint_create failed");

	TEST_ASSERT(network_prov_mgr_start_provisioning(NETWORK_PROV_SECURITY_1, PROV_TEST_POP,
							PROV_TEST_NAME, NULL) == 0,
		    "start_provisioning failed");

	TEST_ASSERT(network_prov_mgr_endpoint_register(PROV_TEST_CUSTOM_EP, custom_echo,
						       NULL) == 0,
		    "endpoint_register failed");

	/* The credential result arrives via prov_event(); keep the device (and
	 * the GATT link) alive so the tester can finish polling status.
	 */
	while (true) {
		k_sleep(K_SECONDS(1));
	}
}

static void dut_main_success(void)
{
	dut_run(WIFI_STATUS_CONN_SUCCESS, NETWORK_PROV_CRED_SUCCESS);
}

static void dut_main_wrong_password(void)
{
	dut_run(WIFI_STATUS_CONN_WRONG_PASSWORD, NETWORK_PROV_CRED_FAIL);
}

static void dut_tick(bs_time_t HW_device_time)
{
	ARG_UNUSED(HW_device_time);
	if (bst_result != Passed) {
		TEST_FAIL("DUT: test did not pass within %d seconds", WAIT_TIME_S);
	}
}

static void dut_init(void)
{
	bst_ticker_set_next_tick_absolute(WAIT_TIME);
	bst_result = In_progress;
}

static const struct bst_test_instance dut_tests[] = {
	{
		.test_id = "dut_success",
		.test_descr = "Provision the DUT successfully over BLE",
		.test_pre_init_f = dut_init,
		.test_tick_f = dut_tick,
		.test_main_f = dut_main_success,
	},
	{
		.test_id = "dut_wrong_password",
		.test_descr = "DUT reports failure when the Wi-Fi password is wrong",
		.test_pre_init_f = dut_init,
		.test_tick_f = dut_tick,
		.test_main_f = dut_main_wrong_password,
	},
	BSTEST_END_MARKER,
};

struct bst_test_list *dut_install(struct bst_test_list *tests)
{
	return bst_add_tests(tests, dut_tests);
}
```

## src/tester.c
```c
/*
 * Tester (device 1): a GATT central that drives a full provisioning flow
 * against the DUT over the real BLE transport, the way the stock ESP BLE
 * provisioning apps and esp_prov do:
 *
 *   scan/connect -> discover the provisioning service -> map endpoints by their
 *   CUD descriptors -> read proto-ver -> run the security-1 handshake (shared
 *   prov_client) -> prov-scan -> prov-config (set + apply) -> poll status.
 *
 * SPDX-License-Identifier: Apache-2.0
 */

#include <string.h>
#include <errno.h>
#include <zephyr/kernel.h>
#include <zephyr/bluetooth/bluetooth.h>
#include <zephyr/bluetooth/conn.h>
#include <zephyr/bluetooth/gatt.h>
#include <zephyr/bluetooth/uuid.h>
#include <zephyr/bluetooth/att.h>
#include <zephyr/net_buf.h>

#include "testlib/conn.h"
#include "testlib/scan.h"
#include "testlib/att.h"
#include "testlib/att_read.h"
#include "testlib/att_write.h"
#include "babblekit/testcase.h"

#include <pb_encode.h>
#include <pb_decode.h>
#include "network_scan.pb.h"
#include "network_config.pb.h"
#include "network_constants.pb.h"
#include "constants.pb.h"

#include "protocomm.h"
#include "prov_client.h"
#include "common.h"

#define WAIT_TIME_S 30
#define WAIT_TIME   (WAIT_TIME_S * 1e6)

/* The DUT overrides the service UUID via network_prov_scheme_ble_set_service_uuid();
 * discovering by it proves the override took effect.
 */
#define PROV_SERVICE_UUID_VAL PROV_TEST_SVC_UUID

static struct bt_conn *g_conn;

/* endpoint name -> GATT value handle, discovered from the CUD descriptors. */
struct ep_entry {
	char name[PROTOCOMM_EP_NAME_MAX];
	uint16_t handle;
};
static struct ep_entry eps[PROTOCOMM_MAX_ENDPOINTS];
static size_t ep_count;

/* --- low-level GATT helpers ----------------------------------------------- */

static int gatt_write(uint16_t handle, const uint8_t *data, uint16_t len)
{
	return bt_testlib_att_write(g_conn, BT_ATT_CHAN_OPT_NONE, handle, data, len);
}

static int gatt_read(uint16_t handle, uint8_t *out, size_t cap, size_t *outlen)
{
	NET_BUF_SIMPLE_DEFINE(buf, 600);
	uint16_t size = 0, mtu = 0;
	int err = bt_testlib_att_read_by_handle_sync(&buf, &size, &mtu, g_conn,
						     BT_ATT_CHAN_OPT_NONE, handle, 0);

	if (err) {
		return -EIO;
	}
	if (buf.len > cap) {
		return -ENOMEM;
	}
	memcpy(out, buf.data, buf.len);
	*outlen = buf.len;
	return 0;
}

static uint16_t ep_handle(const char *name)
{
	for (size_t i = 0; i < ep_count; i++) {
		if (strcmp(eps[i].name, name) == 0) {
			return eps[i].handle;
		}
	}
	return 0;
}

/* --- prov_client transport adapter (plaintext session endpoint) ----------- */

static int gatt_xport(void *ctx, const char *ep, const uint8_t *in, size_t inlen,
		      uint8_t **out, size_t *outlen)
{
	ARG_UNUSED(ctx);
	uint16_t h = ep_handle(ep);

	if (h == 0) {
		return -ENOENT;
	}

	int err = gatt_write(h, in, inlen);

	if (err) {
		return err;
	}

	uint8_t tmp[256];
	size_t n = 0;

	err = gatt_read(h, tmp, sizeof(tmp), &n);
	if (err) {
		return err;
	}

	uint8_t *buf = k_malloc(n > 0 ? n : 1);

	if (buf == NULL) {
		return -ENOMEM;
	}
	memcpy(buf, tmp, n);
	*out = buf;
	*outlen = n;
	return 0;
}

/* --- encrypted endpoint round trip (post-handshake) ----------------------- */

static int secure_exchange(struct prov_client *c, const char *ep,
			   const uint8_t *plain, size_t plen,
			   uint8_t *out, size_t cap, size_t *outlen)
{
	uint16_t h = ep_handle(ep);
	uint8_t enc[256];

	if (h == 0) {
		return -ENOENT;
	}
	if (plen > sizeof(enc)) {
		return -ENOMEM;
	}

	int err = prov_client_xform(c, plain, plen, enc);

	if (err) {
		return err;
	}
	err = gatt_write(h, enc, plen);
	if (err) {
		return err;
	}

	uint8_t resp[256];
	size_t rn = 0;

	err = gatt_read(h, resp, sizeof(resp), &rn);
	if (err) {
		return err;
	}
	if (rn > cap) {
		return -ENOMEM;
	}

	err = prov_client_xform(c, resp, rn, out);
	if (err) {
		return err;
	}
	*outlen = rn;
	return 0;
}

/* --- service / endpoint discovery ----------------------------------------- */

static void read_cud(uint16_t value_handle, char *name, size_t cap)
{
	uint8_t tmp[PROTOCOMM_EP_NAME_MAX + 1];
	size_t n = 0;

	name[0] = '\0';
	/* The CUD descriptor immediately follows the characteristic value. */
	if (gatt_read(value_handle + 1, tmp, sizeof(tmp) - 1, &n) == 0) {
		n = MIN(n, cap - 1);
		memcpy(name, tmp, n);
		name[n] = '\0';
	}
}

static void discover_endpoints(void)
{
	struct bt_uuid_128 svc_uuid = BT_UUID_INIT_128(PROV_SERVICE_UUID_VAL);
	uint16_t svc_start = 0, svc_end = 0;

	int err = bt_testlib_gatt_discover_primary(&svc_start, &svc_end, g_conn,
						   &svc_uuid.uuid, BT_ATT_FIRST_ATTRIBUTE_HANDLE,
						   BT_ATT_LAST_ATTRIBUTE_HANDLE);

	TEST_ASSERT(err == 0, "provisioning service not found (err %d)", err);
	TEST_PRINT("tester: service handles %u..%u", svc_start, svc_end);

	/* Per-endpoint characteristic UUIDs derive from the base with the low
	 * byte varied (protocomm_ble.c). Walk them, then read each CUD to learn
	 * the endpoint name, exactly as the stock apps map endpoints.
	 */
	for (size_t i = 0; i < PROTOCOMM_MAX_ENDPOINTS; i++) {
		struct bt_uuid_128 cuuid = BT_UUID_INIT_128(PROV_SERVICE_UUID_VAL);
		uint16_t vh = 0, end = 0, def = 0;

		cuuid.val[12] = 0xF0 + (uint8_t)i;

		if (bt_testlib_gatt_discover_characteristic(&vh, &end, &def, g_conn,
							    &cuuid.uuid, svc_start,
							    svc_end) != 0) {
			continue;
		}

		read_cud(vh, eps[ep_count].name, sizeof(eps[ep_count].name));
		eps[ep_count].handle = vh;
		TEST_PRINT("tester: endpoint '%s' -> handle %u", eps[ep_count].name, vh);
		ep_count++;
	}

	TEST_ASSERT(ep_handle("prov-session") != 0, "prov-session endpoint missing");
	TEST_ASSERT(ep_handle("prov-scan") != 0, "prov-scan endpoint missing");
	TEST_ASSERT(ep_handle("prov-config") != 0, "prov-config endpoint missing");
}

/* --- provisioning flow ---------------------------------------------------- */

static void check_proto_ver(void)
{
	uint16_t h = ep_handle("proto-ver");
	uint8_t resp[192];
	size_t n = 0;

	TEST_ASSERT(h != 0, "proto-ver endpoint missing");

	/* A protocomm request is a write (which runs the handler and caches the
	 * response) followed by a read of the same characteristic.
	 */
	TEST_ASSERT(gatt_write(h, (const uint8_t *)"---", 3) == 0, "proto-ver write failed");
	TEST_ASSERT(gatt_read(h, resp, sizeof(resp) - 1, &n) == 0, "proto-ver read failed");
	resp[n] = '\0';
	TEST_PRINT("tester: proto-ver = %s", resp);
	TEST_ASSERT(strstr((char *)resp, "sec_ver") != NULL,
		    "proto-ver capabilities missing sec_ver");
	/* The app-info section set by the DUT must be present (set_app_info). */
	TEST_ASSERT(strstr((char *)resp, "\"" PROV_TEST_APP_LABEL "\"") != NULL,
		    "proto-ver missing app-info label");
	TEST_ASSERT(strstr((char *)resp, "\"" PROV_TEST_APP_CAP "\"") != NULL,
		    "proto-ver missing app-info capability");
}

static void do_scan(struct prov_client *c)
{
	uint8_t plain[64], resp[256];
	size_t rn;
	pb_ostream_t os;
	pb_istream_t is;

	/* CmdScanWifiStart(blocking=true): like the stock apps, ask the device to
	 * hold the response until the scan completes. The status poll below is
	 * then satisfied on its first iteration.
	 */
	NetworkScanPayload req = NetworkScanPayload_init_default;

	req.msg = NetworkScanMsgType_TypeCmdScanWifiStart;
	req.which_payload = NetworkScanPayload_cmd_scan_wifi_start_tag;
	req.payload.cmd_scan_wifi_start.blocking = true;

	os = pb_ostream_from_buffer(plain, sizeof(plain));
	TEST_ASSERT(pb_encode(&os, NetworkScanPayload_fields, &req), "scan-start encode");
	TEST_ASSERT(secure_exchange(c, "prov-scan", plain, os.bytes_written, resp,
				    sizeof(resp), &rn) == 0, "scan-start exchange");

	NetworkScanPayload sresp = NetworkScanPayload_init_default;

	is = pb_istream_from_buffer(resp, rn);
	TEST_ASSERT(pb_decode(&is, NetworkScanPayload_fields, &sresp), "scan-start decode");
	TEST_ASSERT(sresp.msg == NetworkScanMsgType_TypeRespScanWifiStart,
		    "scan-start unexpected msg %d (keystream desync?)", sresp.msg);
	TEST_ASSERT(sresp.status == Status_Success, "scan-start status %d", sresp.status);

	/* CmdScanWifiStatus, polled until the scan reports finished (a blocking
	 * start already waits, but poll anyway to be robust to async timing).
	 */
	uint32_t count = 0;
	bool finished = false;

	for (int i = 0; i < 25 && !finished; i++) {
		req = (NetworkScanPayload)NetworkScanPayload_init_default;
		req.msg = NetworkScanMsgType_TypeCmdScanWifiStatus;
		req.which_payload = NetworkScanPayload_cmd_scan_wifi_status_tag;

		os = pb_ostream_from_buffer(plain, sizeof(plain));
		TEST_ASSERT(pb_encode(&os, NetworkScanPayload_fields, &req), "scan-status encode");
		TEST_ASSERT(secure_exchange(c, "prov-scan", plain, os.bytes_written, resp,
					    sizeof(resp), &rn) == 0, "scan-status exchange");

		sresp = (NetworkScanPayload)NetworkScanPayload_init_default;
		is = pb_istream_from_buffer(resp, rn);
		TEST_ASSERT(pb_decode(&is, NetworkScanPayload_fields, &sresp), "scan-status decode");

		finished = sresp.payload.resp_scan_wifi_status.scan_finished;
		count = sresp.payload.resp_scan_wifi_status.result_count;
		if (!finished) {
			k_sleep(K_MSEC(100));
		}
	}

	TEST_ASSERT(finished, "scan never finished");

	TEST_PRINT("tester: scan reported %u AP(s)", count);
	TEST_ASSERT(count == 2, "expected 2 canned APs, got %u", count);
}

static void do_config(struct prov_client *c)
{
	uint8_t plain[96], resp[256];
	size_t rn = 0;
	pb_ostream_t os;
	pb_istream_t is;

	/* CmdSetWifiConfig(ssid, passphrase). */
	NetworkConfigPayload req = NetworkConfigPayload_init_default;

	req.msg = NetworkConfigMsgType_TypeCmdSetWifiConfig;
	req.which_payload = NetworkConfigPayload_cmd_set_wifi_config_tag;
	req.payload.cmd_set_wifi_config.ssid.size = sizeof(PROV_TEST_SSID) - 1;
	memcpy(req.payload.cmd_set_wifi_config.ssid.bytes, PROV_TEST_SSID,
	       sizeof(PROV_TEST_SSID) - 1);
	req.payload.cmd_set_wifi_config.passphrase.size = sizeof(PROV_TEST_PASS) - 1;
	memcpy(req.payload.cmd_set_wifi_config.passphrase.bytes, PROV_TEST_PASS,
	       sizeof(PROV_TEST_PASS) - 1);

	os = pb_ostream_from_buffer(plain, sizeof(plain));
	TEST_ASSERT(pb_encode(&os, NetworkConfigPayload_fields, &req), "set-config encode");
	TEST_ASSERT(secure_exchange(c, "prov-config", plain, os.bytes_written, resp,
				    sizeof(resp), &rn) == 0, "set-config exchange");

	NetworkConfigPayload cresp = NetworkConfigPayload_init_default;

	is = pb_istream_from_buffer(resp, rn);
	TEST_ASSERT(pb_decode(&is, NetworkConfigPayload_fields, &cresp), "set-config decode");
	TEST_ASSERT(cresp.payload.resp_set_wifi_config.status == Status_Success,
		    "set-config rejected");

	/* CmdApplyWifiConfig. */
	req = (NetworkConfigPayload)NetworkConfigPayload_init_default;
	req.msg = NetworkConfigMsgType_TypeCmdApplyWifiConfig;
	req.which_payload = NetworkConfigPayload_cmd_apply_wifi_config_tag;

	os = pb_ostream_from_buffer(plain, sizeof(plain));
	TEST_ASSERT(pb_encode(&os, NetworkConfigPayload_fields, &req), "apply-config encode");
	TEST_ASSERT(secure_exchange(c, "prov-config", plain, os.bytes_written, resp,
				    sizeof(resp), &rn) == 0, "apply-config exchange");

	cresp = (NetworkConfigPayload)NetworkConfigPayload_init_default;
	is = pb_istream_from_buffer(resp, rn);
	TEST_ASSERT(pb_decode(&is, NetworkConfigPayload_fields, &cresp), "apply-config decode");
	TEST_ASSERT(cresp.payload.resp_apply_wifi_config.status == Status_Success,
		    "apply-config rejected");
}

/* Poll GetWifiStatus until it leaves the Connecting state; returns the final
 * WifiStationState.
 */
static int poll_status(struct prov_client *c)
{
	for (int i = 0; i < 50; i++) {
		uint8_t plain[16], resp[256];
		size_t rn;

		NetworkConfigPayload req = NetworkConfigPayload_init_default;

		req.msg = NetworkConfigMsgType_TypeCmdGetWifiStatus;
		req.which_payload = NetworkConfigPayload_cmd_get_wifi_status_tag;

		pb_ostream_t os = pb_ostream_from_buffer(plain, sizeof(plain));

		TEST_ASSERT(pb_encode(&os, NetworkConfigPayload_fields, &req), "status encode");
		TEST_ASSERT(secure_exchange(c, "prov-config", plain, os.bytes_written, resp,
					    sizeof(resp), &rn) == 0, "status exchange");

		NetworkConfigPayload sresp = NetworkConfigPayload_init_default;
		pb_istream_t is = pb_istream_from_buffer(resp, rn);

		TEST_ASSERT(pb_decode(&is, NetworkConfigPayload_fields, &sresp), "status decode");

		int state = sresp.payload.resp_get_wifi_status.wifi_sta_state;

		if (state != WifiStationState_Connecting) {
			return state;
		}
		k_sleep(K_MSEC(200));
	}
	return WifiStationState_Connecting;
}

/* Round-trip through the application custom endpoint over the secure session
 * (network_prov_mgr_endpoint_create/register on the DUT). The DUT echoes
 * "echo:<msg>".
 */
static void verify_custom_endpoint(struct prov_client *c)
{
	uint8_t resp[64];
	size_t rn = 0;
	char expect[64];
	int n = snprintf(expect, sizeof(expect), "echo:%s", PROV_TEST_CUSTOM_MSG);

	TEST_ASSERT(n > 0 && n < (int)sizeof(expect), "expect string truncated");
	TEST_ASSERT(secure_exchange(c, PROV_TEST_CUSTOM_EP,
				    (const uint8_t *)PROV_TEST_CUSTOM_MSG,
				    strlen(PROV_TEST_CUSTOM_MSG), resp, sizeof(resp),
				    &rn) == 0, "custom endpoint exchange failed");
	TEST_ASSERT(rn == (size_t)n && memcmp(resp, expect, n) == 0,
		    "custom endpoint echo mismatch");
	TEST_PRINT("tester: custom endpoint echo OK");
}

static bool mfg_seen;

static bool mfg_ad_cb(struct bt_data *data, void *user_data)
{
	static const uint8_t want[] = PROV_TEST_MFG_DATA;

	ARG_UNUSED(user_data);
	if (data->type == BT_DATA_MANUFACTURER_DATA &&
	    data->data_len == sizeof(want) &&
	    memcmp(data->data, want, sizeof(want)) == 0) {
		mfg_seen = true;
		return false;
	}
	return true;
}

static void mfg_scan_cb(const bt_addr_le_t *addr, int8_t rssi, uint8_t type,
			struct net_buf_simple *ad)
{
	ARG_UNUSED(addr);
	ARG_UNUSED(rssi);
	ARG_UNUSED(type);
	bt_data_parse(ad, mfg_ad_cb, NULL);
}

/* Active-scan and confirm the DUT advertises the manufacturer data set via
 * network_prov_scheme_ble_set_mfg_data() (carried in the scan response).
 */
static void verify_mfg_data(void)
{
	struct bt_le_scan_param param = {
		.type = BT_LE_SCAN_TYPE_ACTIVE,
		.options = BT_LE_SCAN_OPT_NONE,
		.interval = BT_GAP_SCAN_FAST_INTERVAL,
		.window = BT_GAP_SCAN_FAST_WINDOW,
	};

	mfg_seen = false;
	TEST_ASSERT(bt_le_scan_start(&param, mfg_scan_cb) == 0, "mfg scan start failed");
	for (int i = 0; i < 50 && !mfg_seen; i++) {
		k_sleep(K_MSEC(100));
	}
	(void)bt_le_scan_stop();
	TEST_ASSERT(mfg_seen, "manufacturer data not found in scan response");
}

static void tester_run(bool expect_success)
{
	bt_addr_le_t addr;
	int err;

	TEST_ASSERT(bt_enable(NULL) == 0, "bt_enable failed");

	verify_mfg_data();

	err = bt_testlib_scan_find_name(&addr, PROV_TEST_NAME);
	TEST_ASSERT(err == 0, "could not find '%s' (err %d)", PROV_TEST_NAME, err);

	err = bt_testlib_connect(&addr, &g_conn);
	TEST_ASSERT(err == 0, "connect failed (err %d)", err);

	(void)bt_testlib_att_exchange_mtu(g_conn);

	discover_endpoints();
	check_proto_ver();

	struct prov_client c;

	prov_client_init(&c, gatt_xport, NULL);
	TEST_ASSERT(prov_client_handshake(&c, PROV_TEST_POP) == 0,
		    "security-1 handshake failed");
	TEST_PRINT("tester: secure session established");

	verify_custom_endpoint(&c);
	do_scan(&c);
	do_config(&c);

	int state = poll_status(&c);

	if (expect_success) {
		TEST_ASSERT(state == WifiStationState_Connected,
			    "expected Connected, got state %d", state);
	} else {
		TEST_ASSERT(state == WifiStationState_ConnectionFailed,
			    "expected ConnectionFailed, got state %d", state);
	}

	prov_client_destroy(&c);
	TEST_PASS("tester: provisioning flow completed (state %d)", state);
}

static void tester_main_success(void)
{
	tester_run(true);
}

static void tester_main_wrong_password(void)
{
	tester_run(false);
}

static void tester_tick(bs_time_t HW_device_time)
{
	ARG_UNUSED(HW_device_time);
	if (bst_result != Passed) {
		TEST_FAIL("tester: did not pass within %d seconds", WAIT_TIME_S);
	}
}

static void tester_init(void)
{
	bst_ticker_set_next_tick_absolute(WAIT_TIME);
	bst_result = In_progress;
}

static const struct bst_test_instance tester_tests[] = {
	{
		.test_id = "tester_success",
		.test_descr = "Drive a successful provisioning flow over BLE",
		.test_pre_init_f = tester_init,
		.test_tick_f = tester_tick,
		.test_main_f = tester_main_success,
	},
	{
		.test_id = "tester_wrong_password",
		.test_descr = "Drive provisioning and expect a connection failure",
		.test_pre_init_f = tester_init,
		.test_tick_f = tester_tick,
		.test_main_f = tester_main_wrong_password,
	},
	BSTEST_END_MARKER,
};

struct bst_test_list *tester_install(struct bst_test_list *tests)
{
	return bst_add_tests(tests, tester_tests);
}
```
