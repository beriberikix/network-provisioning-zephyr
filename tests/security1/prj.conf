## CMakeLists.txt
```
# SPDX-License-Identifier: Apache-2.0

cmake_minimum_required(VERSION 3.20.0)
find_package(Zephyr REQUIRED HINTS $ENV{ZEPHYR_BASE})
project(security1_test)

target_sources(app PRIVATE
  src/main.c
  ${ZEPHYR_NETWORK_PROVISIONING_MODULE_DIR}/tests/common/prov_client.c
)

# Internal module headers (protocomm.h, security.h), the shared test client and
# the nanopb-generated *.pb.h headers, which land in the module's build dir.
target_include_directories(app PRIVATE
  ${ZEPHYR_NETWORK_PROVISIONING_MODULE_DIR}/src
  ${ZEPHYR_NETWORK_PROVISIONING_MODULE_DIR}/tests/common
  ${CMAKE_BINARY_DIR}/modules/network_provisioning/proto
)
```

## prj.conf
```kconfig
# SPDX-License-Identifier: Apache-2.0

CONFIG_ZTEST=y

CONFIG_NETWORK_PROV_CORE=y
CONFIG_NANOPB=y

# PSA crypto: X25519 ECDH + AES-256-CTR + SHA-256, used by both the device
# side under test and the in-test client implementation.
CONFIG_PSA_CRYPTO=y
CONFIG_MBEDTLS=y
CONFIG_MBEDTLS_PSA_CRYPTO_C=y
CONFIG_MBEDTLS_ENABLE_HEAP=y
CONFIG_MBEDTLS_HEAP_SIZE=16384
CONFIG_ENTROPY_GENERATOR=y
CONFIG_PSA_WANT_ALG_ECDH=y
CONFIG_PSA_WANT_ECC_MONTGOMERY_255=y
CONFIG_PSA_WANT_KEY_TYPE_ECC_KEY_PAIR_GENERATE=y
CONFIG_PSA_WANT_KEY_TYPE_ECC_KEY_PAIR_EXPORT=y
CONFIG_PSA_WANT_KEY_TYPE_ECC_KEY_PAIR_DERIVE=y
CONFIG_PSA_WANT_ALG_CTR=y
CONFIG_PSA_WANT_KEY_TYPE_AES=y
CONFIG_PSA_WANT_ALG_SHA_256=y

# protocomm_new() and response buffers allocate from the kernel heap.
CONFIG_HEAP_MEM_POOL_SIZE=16384

# Crypto needs multi-kB stacks (X25519 field arithmetic).
CONFIG_ZTEST_STACK_SIZE=8192
CONFIG_MAIN_STACK_SIZE=8192
```

## src/main.c
```c
/*
 * Security scheme 1 tests: drive the device side through protocomm_req_handle()
 * with the shared client-side Curve25519 + AES-256-CTR handshake from
 * tests/common/prov_client.c (the inverse of src/security1.c, doing what
 * esp_prov's security1 client does).
 *
 * SPDX-License-Identifier: Apache-2.0
 */

#include <string.h>
#include <errno.h>
#include <zephyr/kernel.h>
#include <zephyr/ztest.h>
#include <pb_encode.h>

#include "session.pb.h"

#include "protocomm.h"
#include "security.h"
#include "prov_client.h"

#define DATA_EP "data"
#define POP     "abcd1234"

static int echo_handler(void *priv, const uint8_t *inbuf, size_t inlen,
			uint8_t **outbuf, size_t *outlen)
{
	static const char prefix[] = "echo:";
	size_t plen = sizeof(prefix) - 1;
	uint8_t *out = k_malloc(plen + inlen);

	if (out == NULL) {
		return -ENOMEM;
	}
	memcpy(out, prefix, plen);
	memcpy(out + plen, inbuf, inlen);
	*outbuf = out;
	*outlen = plen + inlen;
	return 0;
}

/* Transport adapter: a protocomm request is a direct in-process handle call.
 * The signature already matches prov_client_xport_t.
 */
static int pc_xport(void *ctx, const char *ep, const uint8_t *in, size_t inlen,
		    uint8_t **out, size_t *outlen)
{
	return protocomm_req_handle((struct protocomm *)ctx, ep, in, inlen, out, outlen);
}

/* Encrypted request/response round trip through the echo endpoint. */
static void encrypted_echo(struct protocomm *pc, struct prov_client *c,
			   const char *msg)
{
	size_t mlen = strlen(msg);
	uint8_t enc[64];

	zassert_true(mlen <= sizeof(enc));
	zassert_equal(prov_client_xform(c, (const uint8_t *)msg, mlen, enc), 0);

	uint8_t *out = NULL;
	size_t outlen = 0;

	zassert_equal(protocomm_req_handle(pc, DATA_EP, enc, mlen, &out, &outlen),
		      0, "encrypted request failed");

	char plain[80];

	zassert_true(outlen < sizeof(plain));
	zassert_equal(prov_client_xform(c, out, outlen, (uint8_t *)plain), 0);
	plain[outlen] = '\0';
	k_free(out);

	char expect[80];

	snprintf(expect, sizeof(expect), "echo:%s", msg);
	zassert_str_equal(plain, expect);
}

static struct protocomm *make_pc(const char *device_pop)
{
	struct protocomm *pc = protocomm_new();

	zassert_not_null(pc);
	zassert_equal(protocomm_add_endpoint(pc, DATA_EP, echo_handler, NULL), 0);
	zassert_equal(protocomm_set_security(pc, "prov-session",
					     &network_prov_security1, device_pop), 0);
	protocomm_open_session(pc);
	return pc;
}

ZTEST(security1, test_handshake_with_pop_and_echo)
{
	struct protocomm *pc = make_pc(POP);
	struct prov_client c;

	prov_client_init(&c, pc_xport, pc);
	zassert_equal(prov_client_handshake(&c, POP), 0, "handshake failed");

	/* Several messages in a row: the shared CTR keystream must stay in
	 * lock-step across request/response pairs.
	 */
	encrypted_echo(pc, &c, "hello");
	encrypted_echo(pc, &c, "second message, a bit longer");
	encrypted_echo(pc, &c, "3");

	prov_client_destroy(&c);
	protocomm_close_session(pc);
	protocomm_delete(pc);
}

ZTEST(security1, test_handshake_without_pop)
{
	struct protocomm *pc = make_pc(NULL);
	struct prov_client c;

	prov_client_init(&c, pc_xport, pc);
	zassert_equal(prov_client_handshake(&c, NULL), 0, "no-pop handshake failed");
	encrypted_echo(pc, &c, "plain pop-less session");

	prov_client_destroy(&c);
	protocomm_close_session(pc);
	protocomm_delete(pc);
}

ZTEST(security1, test_wrong_pop_rejected)
{
	struct protocomm *pc = make_pc(POP);
	struct prov_client c;

	prov_client_init(&c, pc_xport, pc);

	/* Client derives its key with the wrong PoP: Command0 succeeds (it is
	 * just a key exchange) but the Command1 verification must fail.
	 */
	zassert_equal(prov_client_handshake(&c, "not-the-pop"), -EACCES,
		      "handshake with wrong PoP was not rejected");

	/* And no data may flow on the failed session. */
	uint8_t enc[8] = {0};
	uint8_t *out = NULL;
	size_t outlen = 0;

	zassert_not_equal(protocomm_req_handle(pc, DATA_EP, enc, sizeof(enc),
					       &out, &outlen), 0);

	prov_client_destroy(&c);
	protocomm_close_session(pc);
	protocomm_delete(pc);
}

ZTEST(security1, test_session_reset_allows_rehandshake)
{
	struct protocomm *pc = make_pc(POP);
	struct prov_client c1;
	struct prov_client c2;

	prov_client_init(&c1, pc_xport, pc);
	zassert_equal(prov_client_handshake(&c1, POP), 0);
	encrypted_echo(pc, &c1, "first session");
	prov_client_destroy(&c1);

	/* A transport reconnect resets the session; a fresh handshake with new
	 * keys must succeed.
	 */
	protocomm_open_session(pc);
	prov_client_init(&c2, pc_xport, pc);
	zassert_equal(prov_client_handshake(&c2, POP), 0, "re-handshake failed");
	encrypted_echo(pc, &c2, "second session");

	prov_client_destroy(&c2);
	protocomm_close_session(pc);
	protocomm_delete(pc);
}

ZTEST(security1, test_malformed_handshake_rejected)
{
	struct protocomm *pc = make_pc(POP);
	uint8_t *out = NULL;
	size_t outlen = 0;

	/* Garbage in place of a Command0 / SessionData protobuf: the handshake
	 * must fail (decode error) and leave the session unestablished.
	 */
	static const uint8_t junk[] = {0xff, 0xff, 0xff, 0xff, 0x7f, 0x42, 0x13};

	zassert_not_equal(protocomm_req_handle(pc, "prov-session", junk, sizeof(junk),
					       &out, &outlen), 0,
			  "malformed sec1 handshake must be rejected");
	if (out != NULL) {
		k_free(out);
		out = NULL;
	}

	/* And no encrypted data may flow on the unestablished session. */
	uint8_t enc[8] = {0};

	outlen = 0;
	zassert_not_equal(protocomm_req_handle(pc, DATA_EP, enc, sizeof(enc),
					       &out, &outlen), 0,
			  "data must be rejected without a completed handshake");
	if (out != NULL) {
		k_free(out);
	}

	protocomm_close_session(pc);
	protocomm_delete(pc);
}

ZTEST(security1, test_repeated_command0_restarts_handshake)
{
	struct protocomm *pc = make_pc(POP);

	/* Repeat the full handshake on one transport session, without the
	 * protocomm_open_session() a reconnect would do. Each Command0 must
	 * restart the handshake (upstream parity) and release the previous
	 * session key: iterating past the PSA key-slot count would exhaust
	 * the slots if a key leaked per attempt.
	 */
	for (int i = 0; i < 40; i++) {
		struct prov_client c;

		prov_client_init(&c, pc_xport, pc);
		zassert_equal(prov_client_handshake(&c, POP), 0,
			      "handshake %d on the same session failed", i);
		encrypted_echo(pc, &c, "same session");
		prov_client_destroy(&c);
	}

	protocomm_close_session(pc);
	protocomm_delete(pc);
}

ZTEST(security1, test_rehandshake_after_wrong_pop)
{
	struct protocomm *pc = make_pc(POP);
	struct prov_client bad;
	struct prov_client good;

	/* A failed attempt (wrong PoP) leaves the session in CMD0_DONE; a
	 * retry on the same session must still be able to succeed.
	 */
	prov_client_init(&bad, pc_xport, pc);
	zassert_equal(prov_client_handshake(&bad, "not-the-pop"), -EACCES);
	prov_client_destroy(&bad);

	prov_client_init(&good, pc_xport, pc);
	zassert_equal(prov_client_handshake(&good, POP), 0,
		      "retry after wrong PoP failed");
	encrypted_echo(pc, &good, "recovered");
	prov_client_destroy(&good);

	protocomm_close_session(pc);
	protocomm_delete(pc);
}

ZTEST(security1, test_command0_with_mismatched_payload_rejected)
{
	struct protocomm *pc = make_pc(POP);

	/* msg says Command0 but the payload union carries sc1. */
	SessionData cmd = SessionData_init_default;

	cmd.sec_ver = SecSchemeVersion_SecScheme1;
	cmd.which_proto = SessionData_sec1_tag;
	cmd.proto.sec1.msg = Sec1MsgType_Session_Command0;
	cmd.proto.sec1.which_payload = Sec1Payload_sc1_tag;
	cmd.proto.sec1.payload.sc1.client_verify_data.size = 32;

	uint8_t buf[128];
	pb_ostream_t os = pb_ostream_from_buffer(buf, sizeof(buf));

	zassert_true(pb_encode(&os, SessionData_fields, &cmd));

	uint8_t *out = NULL;
	size_t outlen = 0;

	zassert_not_equal(protocomm_req_handle(pc, "prov-session", buf, os.bytes_written,
					       &out, &outlen), 0,
			  "Command0 with an sc1 payload must be rejected");
	if (out != NULL) {
		k_free(out);
	}

	protocomm_close_session(pc);
	protocomm_delete(pc);
}

ZTEST_SUITE(security1, NULL, NULL, NULL, NULL, NULL);
```
